#include <Adafruit_NeoPixel.h>
#include <Adafruit_NeoMatrix.h>
#include <Adafruit_GFX.h>     // http://librarymanager/All#Adafruit_GFX_Library
#include <Adafruit_DPS310.h>  // http://librarymanager/All#Adafruit_DPS310

#include <SPI.h>
#include <Wire.h>
#include <Adafruit_SSD1306.h>  // http://librarymanager/All#Adafruit_SSD1306

#define WIDTH 12
#define HEIGHT 8

#define SCREEN_WIDTH 128
#define SCREEN_HEIGHT 64
#define OLED_RESET -1

Adafruit_NeoMatrix matrix_2 = Adafruit_NeoMatrix(WIDTH, HEIGHT, 2, NEO_MATRIX_TOP + NEO_MATRIX_LEFT + NEO_MATRIX_ROWS + NEO_MATRIX_ZIGZAG, NEO_GRB + NEO_KHZ800);  //Display
Adafruit_SSD1306 display(SCREEN_WIDTH, SCREEN_HEIGHT, &Wire, OLED_RESET);                                                                                          //LED Matrix
Adafruit_DPS310 dps;


const uint16_t bitmap_sonny[] =  {0x0, 0x0, 0x0, 0x0, 0x0, 0xffe0, 0x0, 0x0, 0x0, 0x0, 0x0, 0x0,
0x0, 0xffe0, 0x0, 0x0, 0x0, 0xffe0, 0x0, 0x0, 0xffe0, 0x0, 0x0, 0x0,
0x0, 0x0, 0xffe0, 0x0, 0x0, 0xffe0, 0x0, 0xffe0, 0x0, 0x0, 0x0, 0x0,
0x0, 0x0, 0x0, 0x0, 0xffe0, 0xffe0, 0xffe0, 0x0, 0x0, 0x0, 0x0, 0x0,
0x0, 0xffe0, 0xffe0, 0xffe0, 0xffe0, 0xffe0, 0xffe0, 0xffe0, 0xffe0, 0xffe0, 0x0, 0x0,
0x0, 0x0, 0x0, 0x0, 0xffe0, 0xffe0, 0xffe0, 0x0, 0x0, 0x0, 0x0, 0x0,
0x0, 0x0, 0x0, 0xffe0, 0x0, 0x0, 0x0, 0xffe0, 0x0, 0x0, 0x0, 0x0,
0x0, 0x0, 0xffe0, 0x0, 0x0, 0x0, 0x0, 0x0, 0xffe0, 0x0, 0x0, 0x0,
};

const uint16_t bitmap_cloud[] =  {0x0, 0x0, 0x0, 0x0, 0x0, 0x0, 0x0, 0x0, 0x0, 0x0, 0x0, 0x0,
0x0, 0x0, 0x0, 0x0, 0x9fff, 0x0, 0x0, 0x0, 0x0, 0x0, 0x0, 0x0,
0x0, 0x0, 0x0, 0x9fff, 0x9fff, 0x9fff, 0x0, 0x0, 0x9fff, 0x9fff, 0x0, 0x0,
0x0, 0x0, 0x9fff, 0x9fff, 0x9fff, 0x9fff, 0x9fff, 0x9fff, 0x9fff, 0x9fff, 0x9fff, 0x0,
0x0, 0x9fff, 0x9fff, 0x9fff, 0x9fff, 0x9fff, 0x9fff, 0x9fff, 0x9fff, 0x9fff, 0x9fff, 0x9fff,
0x0, 0x9fff, 0x9fff, 0x9fff, 0x9fff, 0x9fff, 0x9fff, 0x9fff, 0x9fff, 0x9fff, 0x9fff, 0x9fff,
0x0, 0x0, 0x9fff, 0x9fff, 0x9fff, 0x9fff, 0x9fff, 0x9fff, 0x9fff, 0x9fff, 0x9fff, 0x0,
0x0, 0x0, 0x0, 0x0, 0x0, 0x0, 0x0, 0x0, 0x0, 0x0, 0x0, 0x0,
};

const uint16_t bitmap_cloudAndSunny[] = {0x0, 0x0, 0x0, 0x0, 0x0, 0x0, 0x0, 0x0, 0x0, 0x0, 0x0, 0x0,
0x0, 0x0, 0x0, 0x0, 0x9fff, 0x0, 0x0, 0x0, 0xffe0, 0xffe0, 0xffe0, 0x0,
0x0, 0x0, 0x0, 0x9fff, 0x9fff, 0x9fff, 0x0, 0xffe0, 0xffe0, 0xffe0, 0xffe0, 0xffe0,
0x0, 0x0, 0x9fff, 0x9fff, 0x9fff, 0x9fff, 0x9fff, 0xffe0, 0xffe0, 0xffe0, 0xffe0, 0xffe0,
0x0, 0x9fff, 0x9fff, 0x9fff, 0x9fff, 0x9fff, 0x9fff, 0xffe0, 0x9fff, 0x9fff, 0xffe0, 0xffe0,
0x0, 0x9fff, 0x9fff, 0x9fff, 0x9fff, 0x9fff, 0x9fff, 0x9fff, 0x9fff, 0x9fff, 0x9fff, 0xffe0,
0x0, 0x0, 0x9fff, 0x9fff, 0x9fff, 0x9fff, 0x9fff, 0x9fff, 0x9fff, 0x9fff, 0x9fff, 0x0,
0x0, 0x0, 0x0, 0x0, 0x0, 0x0, 0x0, 0x0, 0x0, 0x0, 0x0, 0x0,
};

const uint16_t bitmap_snow[] = {0x0, 0x0, 0x0, 0x0, 0xcfff, 0x0, 0xcfff, 0x0, 0x0, 0x0, 0x0, 0x0,
0x0, 0x0, 0xcfff, 0x0, 0x0, 0xcfff, 0x0, 0x0, 0xcfff, 0x0, 0x0, 0x0,
0x0, 0x0, 0x0, 0xcfff, 0x0, 0xcfff, 0x0, 0xcfff, 0x0, 0x0, 0x0, 0x0,
0x0, 0x0, 0x0, 0x0, 0xcfff, 0xcfff, 0xcfff, 0x0, 0x0, 0x0, 0x0, 0x0,
0x0, 0x0, 0x0, 0x0, 0xcfff, 0xcfff, 0xcfff, 0x0, 0x0, 0x0, 0x0, 0x0,
0x0, 0x0, 0x0, 0xcfff, 0x0, 0xcfff, 0x0, 0xcfff, 0x0, 0x0, 0x0, 0x0,
0x0, 0x0, 0xcfff, 0x0, 0x0, 0xcfff, 0x0, 0x0, 0xcfff, 0x0, 0x0, 0x0,
0x0, 0x0, 0x0, 0x0, 0xcfff, 0x0, 0xcfff, 0x0, 0x0, 0x0, 0x0, 0x0,
};


void printOnDisplay(String title, String measurement, String unit, String title2, String measurement2, String unit2) {

  display.setCursor(0, 0);
  display.setTextSize(1);
  display.setTextColor(WHITE, BLACK);
  display.println(title);
  display.setCursor(0, 10);
  display.setTextSize(2);
  display.print(measurement);
  display.print(" ");
  display.setTextSize(1);
  display.println(unit);

  display.setCursor(0, 30);
  display.setTextSize(1);
  display.setTextColor(WHITE, BLACK);
  display.println(title2);
  display.setCursor(0, 40);
  display.setTextSize(2);
  display.print(measurement2);
  display.print(" ");
  display.setTextSize(1);
  display.println(unit2);
  display.display();
}



void setup() {

  matrix_2.setBrightness(20);
  matrix_2.setTextWrap(false);
  matrix_2.begin();
  dps.begin_I2C(0x76);

  display.begin(SSD1306_SWITCHCAPVCC, 0x3D);
  display.display();
  delay(100);
  display.clearDisplay();
  dps.begin_I2C(0x76);

  dps.configurePressure(DPS310_64HZ, DPS310_64SAMPLES);
  dps.configureTemperature(DPS310_64HZ, DPS310_64SAMPLES);
}

void loop() {

  delay(5000);
  matrix_2.fillScreen(0);
  matrix_2.show();

  sensors_event_t temp_event, pressure_event;
  dps.getEvents(&temp_event, &pressure_event);

  printOnDisplay("Temperatur", String(temp_event.temperature), "Grad", "Luftdruck", String(pressure_event.pressure), "hpa");

  if ((temp_event.temperature > 20 || pressure_event.pressure > 1020)) {
    matrix_2.drawRGBBitmap(0, 0, bitmap_sonny, WIDTH, HEIGHT);
    matrix_2.show();
  } else if ((temp_event.temperature < 20 || pressure_event.pressure < 1020)) {
    matrix_2.drawRGBBitmap(0, 0, bitmap_cloudAndSunny, WIDTH, HEIGHT);
    matrix_2.show();
    matrix_2.show();
  } else if ((temp_event.temperature < 15 || pressure_event.pressure < 1000)) {
    matrix_2.drawRGBBitmap(0, 0, bitmap_cloud, WIDTH, HEIGHT);
    matrix_2.show();
  } else if (temp_event.temperature < 5) {
    matrix_2.drawRGBBitmap(0, 0, bitmap_snow, WIDTH, HEIGHT);
    matrix_2.show();
  }
}
